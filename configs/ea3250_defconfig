## configs/ea3250_defconfig
```kconfig
BR2_arm=y
BR2_GLOBAL_PATCH_DIR="board/ea3250"
BR2_KERNEL_HEADERS_VERSION=y
BR2_DEFAULT_KERNEL_VERSION="2.6.39.2"
BR2_LINUX_KERNEL=y
BR2_LINUX_KERNEL_CUSTOM_GIT=y
BR2_LINUX_KERNEL_CUSTOM_REPO_URL="git://git.lpclinux.com/linux-2.6.39.2-lpc"
BR2_LINUX_KERNEL_CUSTOM_REPO_VERSION="master"
BR2_LINUX_KERNEL_DEFCONFIG="ea3250"
BR2_TARGET_ROOTFS_JFFS2=y
BR2_TARGET_ROOTFS_JFFS2_NANDFLASH_2K_128K=y
BR2_TARGET_ROOTFS_JFFS2_PAD=y
BR2_TARGET_LPC32XXCDL=y
BR2_TARGET_LPC32XXCDL_BOARDNAME="ea3250"
BR2_TARGET_UBOOT=y
BR2_TARGET_UBOOT_BOARDNAME="ea3250"
BR2_TARGET_UBOOT_CUSTOM_GIT=y
BR2_TARGET_UBOOT_CUSTOM_REPO_URL="git://git.lpclinux.com/uboot-2009.03-lpc32xx"
BR2_TARGET_UBOOT_CUSTOM_REPO_VERSION="master"
BR2_PACKAGE_HOST_LPC3250LOADER=y
```
